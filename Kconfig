## Kconfig
```kconfig
menu "prometheus client library support"

config PROMETHEUS
	bool "mongoose web library"

if PROMETHEUS

config PROMETHEUS_VERBOSE
	bool "Make zcbor code print messages"
	default n

config PROMETHEUS_BUILD_TESTS
	bool "make promethus build test"
	default n

endif #PROMETHEUS

endmenu
```
